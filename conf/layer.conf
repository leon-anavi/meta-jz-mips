## conf/layer.conf
```bitbake
# We have a conf and classes directory, add to BBPATH
BBPATH .= ":${LAYERDIR}"

# We have a recipes-* directories, add to BBFILES
BBFILES += "${LAYERDIR}/recipes-*/*/*.bb \
	${LAYERDIR}/recipes-*/*/*.bbappend"

BBFILE_COLLECTIONS += "jz-mips"
BBFILE_PATTERN_jz-mips = "^${LAYERDIR}/"
BBFILE_PRIORITY_jz-mips = "6"
```

## conf/machine/creator-ci20.conf
```bitbake
#@TYPE: Machine
#@NAME: CI20
#@SOC: Ingenic JZ4780 MIPS
#@DESCRIPTION: MIPS Creator CI20
#@MAINTAINER: Leon Anavi <leon@anavi.org>

require conf/machine/include/tune-mips32r2.inc
IMAGE_CLASSES += "image_types_ci20"

DEFAULTTUNE = "mips32r2el"
MACHINE_FEATURES = "serial"
SERIAL_CONSOLES = "115200;ttyS0 115200;ttyS4"

EXTRA_IMAGEDEPENDS += "u-boot-ci20"
UBOOT_MACHINE = "ci20_mmc"

KERNEL_IMAGETYPE = "uImage"

PREFERRED_PROVIDER_virtual/kernel ?= "linux-creator-ci20"
PREFERRED_VERSION_linux-creator-ci20 ?= "3.18%"
PREFERRED_VERSION_u-boot="u-boot-ci20_2013.10"

MACHINE_ESSENTIAL_EXTRA_RDEPENDS = "kernel kernel-modules"

SDCARD_ROOTFS ?= "${IMGDEPLOYDIR}/${IMAGE_NAME}.rootfs.ext4"
IMAGE_FSTYPES ?= "tar.bz2 ext4 sdcard"
```

## conf/machine/jz-mips.conf
```bitbake
#@TYPE: Machine
#@NAME: jz-mips

#@DESCRIPTION: Machine configuration for jz-mips systems

require conf/machine/include/tune-mips32.inc

MACHINE_FEATURES = "screen keyboard pci usbhost ext2 ext3 serial"

KERNEL_IMAGETYPE = "vmlinux"
KERNEL_ALT_IMAGETYPE = "vmlinux.bin"
KERNEL_IMAGE_STRIP_EXTRA_SECTIONS  = ".comment"


PREFERRED_PROVIDER_virtual/kernel ?= "linux-yocto"
PREFERRED_VERSION_linux-yocto ?= "3.19%"

PREFERRED_PROVIDER_virtual/xserver ?= "xserver-xorg"
XSERVER ?= "xserver-xorg \
            xf86-input-evdev \
            xf86-video-fbdev"

SERIAL_CONSOLE = "115200 ttyS0"
USE_VT ?= "0"

MACHINE_EXTRA_RRECOMMENDS = " kernel-modules"

IMAGE_FSTYPES ?= "jffs2 tar.bz2"
JFFS2_ERASEBLOCK = "0x10000"
```
